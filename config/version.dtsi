#define VERSION_MACRO
macro_ver: macro_ver {
compatible = "zmk,behavior-macro";
#binding-cells = <0>;
bindings = <&kp N2>, <&kp N0>, <&kp N2>, <&kp N5>, <&kp N0>, <&kp N5>, <&kp N0>, <&kp N2>, <&kp MINUS>, <&kp M>, <&kp Y>, <&kp F>, <&kp MINUS>, <&kp C>, <&kp N4>, <&kp N9>, <&kp N8>, <&kp N9>, <&kp F>, <&kp F>, <&kp MINUS>, <&kp C>, <&kp L>, <&kp I>, <&kp Q>, <&kp U>, <&kp E>, <&kp RET>;
};
